## sources/meta-bsp_embedos/conf/layer.conf
```bitbake
# We have a conf and classes directory, add to BBPATH
BBPATH .= ":${LAYERDIR}"

# We have recipes-* directories, add to BBFILES
BBFILES += "${LAYERDIR}/recipes-*/*/*.bb \
            ${LAYERDIR}/recipes-*/*/*.bbappend"

BBFILE_COLLECTIONS += "bsp_embedos"
BBFILE_PATTERN_bsp_embedos = "^${LAYERDIR}/"
BBFILE_PRIORITY_bsp_embedos = "6"

LAYERDEPENDS_bsp_embedos = "core"
LAYERDEPENDS_bsp_embedos = "raspberrypi"
LAYERSERIES_COMPAT_bsp_embedos = "gatesgarth"

## TODO: Rename to sth more resembling board like hhhctrl-bsp-etc
```

## sources/meta-bsp_embedos/conf/machine/hhctrl.conf
```bitbake
#@TYPE: Machine
#@NAME: Henhouse Controller based on RPI Zero W
#@DESCRIPTION: Henhouse Controller

require conf/machine/raspberrypi0-wifi.conf

MACHINEOVERRIDES =. "raspberrypi0-wifi:"

# TOOD: This is needed when using core-image-minimal, when everythinks works fine, it may be deleted
# MACHINE_ESSENTIAL_EXTRA_RRECOMMENDS_append = " \
#      wpa-supplicant \
#      linux-firmware-rpidistro-bcm43430 \
#      kernel-modules \
#      udev-rules-rpi \
# "

MACHINE_FEATURES_remove = " screen touchscreen alsa"

### Enables uboot - raspberrypi specific
RPI_USE_U_BOOT = "1"

### Enables UART - raspberrypi specific
ENABLE_UART = "1"

### Without this, there is an additional check in runtime and write to inittab
SERIAL_CONSOLES_CHECK = ""

### HW PWM support on board ###
KERNEL_DEVICETREE_append = " overlays/pwm.dtbo"
RPI_EXTRA_CONFIG_append = " dtoverlay=pwm,pin=12,func=4"
```

## sources/meta-sheli/conf/distro/include/common.conf
```bitbake
require conf/distro/poky.conf

DISTRO_FEATURES_append = " wifi" 
DISTRO_FEATURES_remove = " opengl wayland vulkan"

TCLIBCAPPEND = ""

require conf/distro/include/poky-distro-alt-test-config.inc
```

## sources/meta-sheli/conf/distro/sheli-integration.conf
```bitbake
#
# An example of subclassing a distro, primarily used for testing alternate configuration
# combinations on the Yocto Project autobuilder
#

require conf/distro/include/common.conf

DISTRO = "sheli-integration"
DISTRO_NAME = "Sheli-Integration (Smart Home Embedded Linux)"
DISTRO_VERSION = "1.0.0"
DISTRO_STAGE = "integration"
DISTROOVERRIDES = "poky:sheli-integration"
```

## sources/meta-sheli/conf/distro/sheli.conf
```bitbake
DISTRO = "sheli"
DISTRO_NAME = "Sheli (Smart Home Embedded Linux)"
DISTRO_VERSION = "1.0.0"

SHELI_DEFAULT_DISTRO_FEATURES = "largefile ptest"
SHELI_DEFAULT_EXTRA_RDEPENDS = "packagegroup-core-boot"
SHELI_DEFAULT_EXTRA_RRECOMMENDS = "kernel-module-af-packet"

DISTRO_FEATURES ?= "${DISTRO_FEATURES_DEFAULT} ${SHELI_DEFAULT_DISTRO_FEATURES}"

SDK_NAME = "${DISTRO}-${TCLIBC}-${SDKMACHINE}-${IMAGE_BASENAME}-${TUNE_PKGARCH}-${MACHINE}"
SDKPATH = "/opt/${DISTRO}/${SDK_VERSION}"

DISTRO_EXTRA_RDEPENDS += " ${SHELI_DEFAULT_EXTRA_RDEPENDS}"
DISTRO_EXTRA_RRECOMMENDS += " ${SHELI_DEFAULT_EXTRA_RRECOMMENDS}"

require conf/distro/include/no-static-libs.inc
require conf/distro/include/yocto-uninative.inc
require conf/distro/include/security_flags.inc

INHERIT += "uninative"

INHERIT += "reproducible_build"

BB_SIGNATURE_HANDLER ?= "OEEquivHash"
BB_HASHSERVE ??= "auto"
```

## sources/meta-sheli/conf/layer.conf
```bitbake
# We have a conf and classes directory, add to BBPATH
BBPATH .= ":${LAYERDIR}"

# We have recipes-* directories, add to BBFILES
BBFILES += "${LAYERDIR}/recipes-*/*/*.bb \
            ${LAYERDIR}/recipes-*/*/*.bbappend"


BBFILE_COLLECTIONS += "meta-sheli"

BBFILE_PATTERN_meta-sheli = "^${LAYERDIR}/"
BBFILE_PRIORITY_meta-sheli = "6"

LAYERDEPENDS_meta-sheli = "core"
LAYERSERIES_COMPAT_meta-sheli = "gatesgarth"
```

## sources/meta-shmpc-os/conf/distro/sheli-dev.conf
```bitbake
#
# An example of subclassing a distro, primarily used for testing alternate configuration
# combinations on the Yocto Project autobuilder
#

require conf/distro/include/common.conf

DISTRO = "sheli-dev"
DISTRO_NAME = "Sheli-Dev (Smart Home Embedded Linux)"
DISTRO_VERSION = "1.0.0"
DISTRO_STAGE = "dev"
DISTROOVERRIDES = "poky:sheli-dev"
```
